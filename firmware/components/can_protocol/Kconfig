## firmware/components/can_protocol/Kconfig
```kconfig
menu "CAN bench node configuration"

config CAN_BENCH_TWAI_TX_GPIO
    int "TWAI TX GPIO"
    range 0 33
    default 21
    help
        GPIO routed to the CTX pin of the SN65HVD230 compatible transceiver.

config CAN_BENCH_TWAI_RX_GPIO
    int "TWAI RX GPIO"
    range 0 39
    default 22
    help
        GPIO routed to the CRX pin of the SN65HVD230 compatible transceiver.

endmenu
```

## firmware/thermal_controller/sdkconfig.defaults
```kconfig
CONFIG_FREERTOS_HZ=1000
CONFIG_ESP_MAIN_TASK_STACK_SIZE=4096
CONFIG_ESP_TASK_WDT_EN=y
CONFIG_COMPILER_OPTIMIZATION_SIZE=y
CONFIG_ESP_CONSOLE_UART_DEFAULT=y
CONFIG_ESP_CONSOLE_UART_BAUDRATE=115200
```
